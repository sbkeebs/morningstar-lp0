## boards/shields/morningstar-lp0/Kconfig.defconfig
```kconfig
if SHIELD_MORNINGSTAR-LP0

# Name must be less than 16 characters long!
config ZMK_KEYBOARD_NAME
    default "Morningstar LP0"

endif
```

## boards/shields/morningstar-lp0/Kconfig.shield
```kconfig
config SHIELD_MORNINGSTAR-LP0
    def_bool $(shields_list_contains,morningstar-lp0)
```
